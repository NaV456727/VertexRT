#include <xtensa/coreasm.h>
#include <xtensa/corebits.h>
#include <xtensa/xtensa_context.h>

.text
.align 4

/*
 * ============================================================================
 * VertexRT ESP32 Xtensa port
 *
 * Xtensa context mechanisms are taken directly from the ESP32 FreeRTOS
 * model:
 *
 *   - XtExcFrame
 *   - XtSolFrame
 *   - _xt_context_restore()
 *   - xthal_window_spill_nw()
 *   - _xt_user_exit
 *   - retw for solicited frames
 *
 * VertexRT's C scheduler selects the next task.
 *
 * This assembly file is responsible ONLY for the CPU context transition.
 * ============================================================================
 */


/*
 * ============================================================================
 * External Xtensa runtime routines
 * ============================================================================
 */

.extern _xt_context_restore
.extern xthal_window_spill_nw
.extern _xt_user_exit


/*
 * ============================================================================
 * VertexRT context-switch handoff variables
 * ============================================================================
 *
 * Defined in vrt_port.c:
 *
 *     volatile uint32_t **vrt_port_current_sp;
 *     volatile uint32_t  *vrt_port_next_sp;
 *
 * The C wrapper writes these before entering vrt_port_yield_switch().
 *
 * We deliberately do NOT pass the pointers in A2/A3 because the register
 * window spill routine is allowed to destroy caller-saved registers.
 * ============================================================================
 */

.extern vrt_port_current_sp
.extern vrt_port_next_sp


/*
 * ============================================================================
 * vrt_port_start_first_task
 *
 * C prototype:
 *
 *     void vrt_port_start_first_task(uint32_t *sp);
 *
 * Called using the normal Xtensa windowed ABI.
 *
 * Therefore:
 *
 *     A10 = sp
 *
 * The initial task stack is a complete XtExcFrame generated by the ESP32
 * FreeRTOS pxPortInitialiseStack().
 *
 * This path is already proven working and should not be changed.
 *
 * Does not return.
 * ============================================================================
 */

.global vrt_port_start_first_task
.type   vrt_port_start_first_task, @function
.align  4

vrt_port_start_first_task:

    /*
     * A10 contains the initial task frame pointer.
     */
    mov     a1, a10

    /*
     * Restore the general register context from the XtExcFrame.
     */
    call0   _xt_context_restore

    /*
     * The first word of the frame is the exit dispatcher.
     *
     * For a FreeRTOS-generated initial task frame this is:
     *
     *     _xt_user_exit
     */
    l32i    a0, a1, XT_STK_EXIT

    /*
     * Transfer directly to the Xtensa exit dispatcher.
     *
     * Do not return through the scheduler's CALL8 frame.
     */
    jx      a0


/*
 * ============================================================================
 * vrt_port_restore_context_asm
 *
 * Internal assembly backend for the public C function:
 *
 *     vrt_port_restore_context()
 *
 * C prototype:
 *
 *     void vrt_port_restore_context_asm(uint32_t *sp);
 *
 * Entry:
 *
 *     A10 = target task SP
 *
 * No current task is saved.
 *
 * Does not return.
 * ============================================================================
 */

.global vrt_port_restore_context_asm
.type   vrt_port_restore_context_asm, @function
.align  4

vrt_port_restore_context_asm:

    /*
     * The normal windowed ABI passes the first C argument in A10.
     */
    mov     a1, a10

    /*
     * Determine frame type.
     *
     * EXIT != 0  -> full XtExcFrame
     * EXIT == 0  -> solicited XtSolFrame
     */
    l32i    a3, a1, XT_STK_EXIT

    bnez    a3, .L_restore_full


/*
 * --------------------------------------------------------------------------
 * Restore solicited frame
 * --------------------------------------------------------------------------
 */

.L_restore_solicited:

#if XCHAL_HAVE_THREADPTR

    l32i    a2, a1, XT_SOL_THREADPTR
    wur.threadptr a2

#endif

    /*
     * Restore saved PS and PC.
     */
    l32i    a3, a1, XT_SOL_PS
    l32i    a0, a1, XT_SOL_PC

    /*
     * Restore processor status.
     */
    wsr     a3, PS
    rsync

    /*
     * Remove the solicited frame.
     */
    addi    a1, a1, XT_SOL_FRMSZ

    /*
     * Resume the task.
     */
    retw


/*
 * --------------------------------------------------------------------------
 * Restore full XtExcFrame
 * --------------------------------------------------------------------------
 */

.L_restore_full:

    /*
     * Restore the complete general register context.
     */
    call0   _xt_context_restore

    /*
     * Retrieve the Xtensa exit dispatcher.
     */
    l32i    a0, a1, XT_STK_EXIT

    /*
     * Transfer to the saved exit dispatcher.
     */
    jx      a0


/*
 * ============================================================================
 * vrt_port_yield_switch
 *
 * Internal low-level voluntary context switch.
 *
 * C wrapper:
 *
 *     vrt_port_switch_context(
 *         &current->sp,
 *         next->sp
 *     );
 *
 * The wrapper stores those values in:
 *
 *     vrt_port_current_sp
 *     vrt_port_next_sp
 *
 * This function:
 *
 *     1. creates an XtSolFrame on the current task's stack
 *     2. saves PC/PS/threadptr
 *     3. spills the active Xtensa register windows
 *     4. saves the resulting SP into current->sp
 *     5. loads next->sp
 *     6. determines whether next has:
 *           - a full initial XtExcFrame
 *           - a solicited XtSolFrame
 *     7. restores and transfers execution
 *
 * It returns only when the task that originally called
 * vrt_task_yield() is scheduled again.
 * ============================================================================
 */

.global vrt_port_yield_switch
.type   vrt_port_yield_switch, @function
.align  4

vrt_port_yield_switch:

    /*
     * ----------------------------------------------------------------------
     * Allocate the Xtensa solicited frame.
     *
     * This follows FreeRTOS vPortYield().
     * ----------------------------------------------------------------------
     */

    entry   a1, XT_SOL_FRMSZ
    
    /*
     * Mark this as a solicited frame.
     *
     * XT_SOL_EXIT == 0 distinguishes XtSolFrame from XtExcFrame.
     */
    movi a2, 0
    s32i a2, a1, XT_SOL_EXIT


    /*
     * ----------------------------------------------------------------------
     * Save current task PC and PS.
     * ----------------------------------------------------------------------
     */

    rsr     a2, PS

    s32i    a0, a1, XT_SOL_PC
    s32i    a2, a1, XT_SOL_PS


#if XCHAL_HAVE_THREADPTR

    /*
     * Preserve THREADPTR as a callee-saved value.
     */
    rur.threadptr a2
    s32i    a2, a1, XT_SOL_THREADPTR

#endif


    /*
     * ----------------------------------------------------------------------
     * Spill register windows.
     *
     * This is the same fundamental operation used by FreeRTOS vPortYield().
     *
     * Temporarily:
     *
     *     WOE      = 0
     *     INTLEVEL = XCHAL_EXCM_LEVEL
     *
     * then spill all outstanding register windows.
     * ----------------------------------------------------------------------
     */

    movi    a6, ~(PS_WOE_MASK | PS_INTLEVEL_MASK)

    and     a2, a2, a6

    addi    a2, a2, XCHAL_EXCM_LEVEL

    wsr     a2, PS
    rsync

    call0   xthal_window_spill_nw


    /*
     * ----------------------------------------------------------------------
     * Restore the task's original PS.
     * ----------------------------------------------------------------------
     */

    l32i    a2, a1, XT_SOL_PS

    wsr     a2, PS
    rsync


    /*
     * ----------------------------------------------------------------------
     * Disable lower/medium priority interrupts while changing SP state.
     * ----------------------------------------------------------------------
     */

    rsil    a2, XCHAL_EXCM_LEVEL


    /*
     * ----------------------------------------------------------------------
     * Obtain currentTask->sp destination.
     *
     * vrt_port_current_sp is:
     *
     *     &currentTask->sp
     *
     * so:
     *
     *     a2 = address of currentTask->sp
     * ----------------------------------------------------------------------
     */

    movi    a2, vrt_port_current_sp
    l32i    a2, a2, 0


    /*
     * Save the current task's solicited frame SP.
     *
     *     currentTask->sp = a1
     */
    s32i    a1, a2, 0


    /*
     * ----------------------------------------------------------------------
     * Obtain nextTask->sp.
     *
     * vrt_port_next_sp contains the actual saved SP value.
     * ----------------------------------------------------------------------
     */

    movi    a2, vrt_port_next_sp
    l32i    a1, a2, 0


    /*
     * ----------------------------------------------------------------------
     * Inspect target frame.
     * ----------------------------------------------------------------------
     *
     * EXIT == 0:
     *
     *     solicited frame created by a previous yield
     *
     * EXIT != 0:
     *
     *     initial/full XtExcFrame created by pxPortInitialiseStack()
     */

    l32i    a2, a1, XT_STK_EXIT

    bnez    a2, .L_switch_full


/*
 * --------------------------------------------------------------------------
 * Restore solicited target
 * --------------------------------------------------------------------------
 */

.L_switch_solicited:

#if XCHAL_HAVE_THREADPTR

    l32i    a2, a1, XT_SOL_THREADPTR
    wur.threadptr a2

#endif

    /*
     * Restore target PS and PC.
     */
    l32i    a3, a1, XT_SOL_PS
    l32i    a0, a1, XT_SOL_PC

    /*
     * Restore target processor status.
     */
    wsr     a3, PS
    rsync

    /*
     * Remove target's solicited frame.
     */
    addi    a1, a1, XT_SOL_FRMSZ

    /*
     * Resume target task.
     */
    retw


/*
 * --------------------------------------------------------------------------
 * Restore full initial task frame
 * --------------------------------------------------------------------------
 */

.L_switch_full:

    /*
     * Restore the complete XtExcFrame.
     */
    call0   _xt_context_restore

    /*
     * Fetch the saved exit dispatcher.
     *
     * For the initial frame created by FreeRTOS:
     *
     *     a0 = _xt_user_exit
     */
    l32i    a0, a1, XT_STK_EXIT

    /*
     * Transfer into the Xtensa exit dispatcher.
     */
    jx      a0


.size vrt_port_yield_switch, .-vrt_port_yield_switch